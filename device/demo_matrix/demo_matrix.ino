//tm1,640-d,ual c,olor ,8x8 matrix
//high 8bit -> green
//low 8bit -> red
#define CLK 5
#define DIN 4

#define D 2
byte alphabet[12][16] = {
  {0x7F, 0x09, 0x19, 0x29, 0x46, 0x00, 0x00, 0x00, 0x7F, 0x09, 0x19, 0x29, 0x46, 0x00, 0x00, 0x00},
  {0x00, 0x42, 0x7F, 0x40, 0x00, 0x00, 0x00, 0x00, 0x00, 0x42, 0x7F, 0x40, 0x00, 0x00, 0x00, 0x00},
  {0x42, 0x61, 0x51, 0x49, 0x46, 0x00, 0x00, 0x00, 0x42, 0x61, 0x51, 0x49, 0x46, 0x00, 0x00, 0x00},
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  {0xff, 0x00, 0xff, 0x00, 0xff, 0x00, 0xff, 0x00, 0x00, 0xff, 0x00, 0xff, 0x00, 0xff, 0x00, 0xff}
};


void start() {
  digitalWrite(CLK, HIGH); delayMicroseconds(D);
  digitalWrite(DIN, HIGH); delayMicroseconds(D);
  digitalWrite(DIN, LOW); delayMicroseconds(D);
  digitalWrite(CLK, LOW); delayMicroseconds(D);
}
void stop() {
  digitalWrite(CLK, HIGH); delayMicroseconds(D);
  digitalWrite(DIN, LOW); delayMicroseconds(D);

  digitalWrite(DIN, HIGH); delayMicroseconds(D);
}
void write_byte(byte b) {
  static byte i;
  digitalWrite(CLK, LOW); delayMicroseconds(D);
  for (i = 0; i < 8; i++) {
    Serial.print(b & 0x01);

    if (b & 0x01) {
      //write HIGH
      digitalWrite(DIN, HIGH);
    } else {
      //write LOW
      digitalWrite(DIN, LOW);
    }
    delayMicroseconds(D);

    digitalWrite(CLK, HIGH); delayMicroseconds(D);
    digitalWrite(CLK, LOW); delayMicroseconds(D);

    b >>= 1;
  }
  Serial.println("");
}
void cmd(byte c) {
  start();
  write_byte(c);
  stop();
}

void write_block(int slice) {
  static byte c;
  start();
  //start from 0x00
  write_byte(0xc0);
  //write 16 bytes profile
  for (c = 0; c < 16; c++) {
    write_byte(alphabet[slice][c]);
    //write_byte(0xff);
  }
  stop();
}
void setup() {
  // put your setup code here, to run once:
  Serial.begin(115200);
  Serial.println("init");
  delay(1);
  pinMode(DIN, OUTPUT);
  pinMode(CLK, OUTPUT);
  digitalWrite(DIN, HIGH);
  digitalWrite(CLK, HIGH);
  delay(1);

  cmd(0x40);
  start();
  write_byte(0xcf);
  write_byte(0xff);
  stop();
  cmd(0x8c);
  //cmd(0x40);
}

int x = 0;
void loop() {
  delay(500);
  Serial.println("data");
  // put your main code here, to run repeatedly:
  write_block(x);

  x = (x + 1) % 11;

}
